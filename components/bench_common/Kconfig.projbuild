## components/bench_common/Kconfig.projbuild
```kconfig
menu "Bench Configuration"

    menu "WiFi Configuration"

        config BENCH_WIFI_SSID
            string "WiFi SSID"
            default "myssid"
            help
                SSID of the access point to connect to.

        config BENCH_WIFI_PASSWORD
            string "WiFi Password"
            default "mypassword"
            help
                PSK for the access point.

        config BENCH_WIFI_MAX_RETRY
            int "Maximum retry"
            default 5
            help
                Number of reconnect attempts before giving up.

        choice BENCH_WIFI_AUTH_MODE
            prompt "Minimum Auth Mode"
            default BENCH_WIFI_AUTH_WPA2_PSK
            help
                Minimum authentication mode accepted by the STA.

            config BENCH_WIFI_AUTH_OPEN
                bool "OPEN"
            config BENCH_WIFI_AUTH_WEP
                bool "WEP"
            config BENCH_WIFI_AUTH_WPA_PSK
                bool "WPA PSK"
            config BENCH_WIFI_AUTH_WPA2_PSK
                bool "WPA2 PSK"
            config BENCH_WIFI_AUTH_WPA_WPA2_PSK
                bool "WPA/WPA2 PSK"
            config BENCH_WIFI_AUTH_WPA3_PSK
                bool "WPA3 PSK"
            config BENCH_WIFI_AUTH_WPA2_WPA3_PSK
                bool "WPA2/WPA3 PSK"
        endchoice

    endmenu

    menu "Transport Target"

        config BENCH_TARGET_IPV4
            string "Destination IPv4 address"
            default "192.168.1.100"
            help
                Address of the receiving PC (micro-ROS agent host or Proton peer).

        config BENCH_TARGET_PORT
            int "Destination UDP port"
            default 8888

    endmenu

endmenu
```

## main/Kconfig.projbuild
```kconfig
menu "Proton Bench Configuration"

    config ESP_WIFI_SSID
        string "WiFi SSID"
        default "myssid"
        help
            SSID of the access point to connect to.

    config ESP_WIFI_PASSWORD
        string "WiFi Password"
        default "mypassword"
        help
            PSK for the access point.

    config ESP_MAXIMUM_RETRY
        int "Maximum retry"
        default 5
        help
            Number of reconnect attempts before giving up.

    choice ESP_WIFI_SCAN_AUTH_MODE_THRESHOLD
        prompt "Minimum Auth Mode"
        default ESP_WIFI_AUTH_WPA2_PSK
        help
            Minimum authentication mode accepted by the STA.

        config ESP_WIFI_AUTH_OPEN
            bool "OPEN"
        config ESP_WIFI_AUTH_WEP
            bool "WEP"
        config ESP_WIFI_AUTH_WPA_PSK
            bool "WPA PSK"
        config ESP_WIFI_AUTH_WPA2_PSK
            bool "WPA2 PSK"
        config ESP_WIFI_AUTH_WPA_WPA2_PSK
            bool "WPA/WPA2 PSK"
        config ESP_WIFI_AUTH_WPA3_PSK
            bool "WPA3 PSK"
        config ESP_WIFI_AUTH_WPA2_WPA3_PSK
            bool "WPA2/WPA3 PSK"
    endchoice

endmenu
```

## micro_ros/sdkconfig.defaults
```kconfig
CONFIG_IDF_TARGET="esp32c6"

CONFIG_ESP_MAIN_TASK_STACK_SIZE=6144
CONFIG_FREERTOS_HZ=100
CONFIG_LOG_DEFAULT_LEVEL_INFO=y

CONFIG_ESP_WIFI_ENABLE_WPA3_SAE=y

CONFIG_MICRO_ROS_APP_STACK=16000
CONFIG_MICRO_ROS_APP_TASK_PRIO=5

# micro-ROS agent
CONFIG_MICRO_ROS_AGENT_IP="192.168.1.169"
CONFIG_MICRO_ROS_AGENT_PORT="8888"
```

## proton/main/Kconfig.projbuild
```kconfig
menu "Proton Example Configuration"
    config PROTON_TASK_STACK
        int "Proton task stack"
        default 3072
        help
            Stack size in bytes of the proton task
        
    config PROTON_TASK_PRIO
        int "Priority of the proton task"
        default 5
        help
            Priority of proton task higher value means higher priority

endmenu
```

## proton/sdkconfig.defaults
```kconfig
CONFIG_IDF_TARGET="esp32c6"

CONFIG_COMPILER_OPTIMIZATION_SIZE=y

CONFIG_ESP_MAIN_TASK_STACK_SIZE=6144
CONFIG_FREERTOS_HZ=1000
CONFIG_LOG_DEFAULT_LEVEL_INFO=y

CONFIG_ESP_WIFI_ENABLE_WPA3_SAE=y

CONFIG_PROTON_TASK_STACK=3072
CONFIG_PROTON_TASK_PRIO=5
```

## sdkconfig.defaults
```kconfig
CONFIG_IDF_TARGET="esp32c6"

CONFIG_ESP_MAIN_TASK_STACK_SIZE=6144
CONFIG_FREERTOS_HZ=100
CONFIG_LOG_DEFAULT_LEVEL_INFO=y

CONFIG_ESP_WIFI_ENABLE_WPA3_SAE=y
```

## zenoh/main/Kconfig.projbuild
```kconfig
menu "Zenoh Example Configuration"
    config ZENOH_TASK_STACK
        int "Zenoh task stack"
        default 3072
        help
            Stack size in bytes of the zenoh task
        
    config ZENOH_TASK_PRIO
        int "Priority of the zenoh task"
        default 5
        help
            Priority of zenoh task higher value means higher priority

endmenu
```
